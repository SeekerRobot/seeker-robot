## mcu_ws/src/main_satellite/sdkconfig.defaults
```kconfig
# S3-Sense-only. Referenced exclusively by [env:esp32s3sense_satellite] via
# board_build.esp-idf.sdkconfig_defaults. The esp32cam_satellite env uses
# stock espressif32 (Arduino 2.x) and relies on -DBOARD_HAS_PSRAM +
# -mfix-esp32-psram-cache-issue instead — do NOT extend this file with
# esp32cam-compatible options; add a sibling sdkconfig.defaults.esp32cam
# file if that ever becomes necessary.

# --- PSRAM (8 MB octal on XIAO S3 Sense) ---
CONFIG_ESP32S3_SPIRAM_SUPPORT=y
CONFIG_SPIRAM=y
CONFIG_SPIRAM_MODE_OCT=y
CONFIG_SPIRAM_TYPE_AUTO=y
CONFIG_SPIRAM_SPEED_80M=y
CONFIG_SPIRAM_BOOT_INIT=y
CONFIG_SPIRAM_USE_MALLOC=y
CONFIG_SPIRAM_TRY_ALLOCATE_WIFI_LWIP=y
CONFIG_SPIRAM_MALLOC_ALWAYSINTERNAL=16384
CONFIG_SPIRAM_MALLOC_RESERVE_INTERNAL=32768

# --- WiFi static + dynamic buffers ---
CONFIG_ESP_WIFI_STATIC_RX_BUFFER_NUM=16
CONFIG_ESP_WIFI_DYNAMIC_RX_BUFFER_NUM=32
CONFIG_ESP_WIFI_DYNAMIC_TX_BUFFER_NUM=32
CONFIG_ESP_WIFI_CACHE_TX_BUFFER_NUM=32
CONFIG_ESP_WIFI_TX_BA_WIN=16
CONFIG_ESP_WIFI_RX_BA_WIN=16
CONFIG_ESP_WIFI_AMPDU_TX_ENABLED=y
CONFIG_ESP_WIFI_AMPDU_RX_ENABLED=y
CONFIG_ESP_WIFI_IRAM_OPT=y
CONFIG_ESP_WIFI_RX_IRAM_OPT=y

# --- lwIP windows + mboxes ---
CONFIG_LWIP_TCP_SND_BUF_DEFAULT=16384
CONFIG_LWIP_TCP_WND_DEFAULT=16384
CONFIG_LWIP_TCP_RECVMBOX_SIZE=32
CONFIG_LWIP_UDP_RECVMBOX_SIZE=16
CONFIG_LWIP_TCPIP_RECVMBOX_SIZE=64
CONFIG_LWIP_TCP_MSL=6000
CONFIG_LWIP_TCP_MAX_RETRANSMIT=8

# --- Bluetooth disabled ---
# BLE debug transport removed — WiFi + UDP safe-mode reset + Serial cover
# recovery and observability, so the controller and NimBLE host are disabled
# entirely to reclaim flash and internal RAM.
CONFIG_BT_ENABLED=n
CONFIG_BT_NIMBLE_ENABLED=n
```
